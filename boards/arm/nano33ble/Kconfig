## boards/arm/nano33ble/Kconfig
```kconfig
# SPDX-License-Identifier: MIT
# TODO i have no idea what this is
config BOARD_ENABLE_DCDC
    bool "Enable DCDC mode"
    select SOC_DCDC_NRF52X
    default y
    depends on (BOARD_NANO_33_BLE)
```

## boards/arm/nano33ble/Kconfig.board
```kconfig
# nice!nano board configuration

# Copyright (c) 2020 Pete Johanson
# SPDX-License-Identifier: MIT

config BOARD_NANO_33_BLE
    bool "nano_33_ble"
    depends on SOC_NRF52840_QIAA
```

## boards/arm/nano33ble/Kconfig.defconfig
```kconfig
# Copyright (c) 2021 The ZMK Contributors
# SPDX-License-Identifier: MIT

if BOARD_NANO_33_BLE

config BOARD
    default "nano_33_ble"

if USB_DEVICE_STACK

config USB_NRFX
    default y

endif # USB_DEVICE_STACK

config BT_CTLR
    default BT

endif # BOARD_NANO_33_BLE
```
